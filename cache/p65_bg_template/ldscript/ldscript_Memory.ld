MEMORY
{
  /*
   * Part 1: memory Layout
   */

  /* SRAM near banks, [0x0000_0000, 0x000B_FFFF], for CORE0/CORE1/CLA0/CLA1 Instruction and Data */
  SRAM_N_BANK00    : ORIGIN = 0x00000000, LENGTH = 0x00008000
  SRAM_N_BANK01    : ORIGIN = 0x00008000, LENGTH = 0x00008000
  SRAM_N_BANK02    : ORIGIN = 0x00010000, LENGTH = 0x00008000
  SRAM_N_BANK03    : ORIGIN = 0x00018000, LENGTH = 0x00008000

  SRAM_N_BANK04    : ORIGIN = 0x00020000, LENGTH = 0x00008000
  SRAM_N_BANK05    : ORIGIN = 0x00028000, LENGTH = 0x00008000
  SRAM_N_BANK06    : ORIGIN = 0x00030000, LENGTH = 0x00008000
  SRAM_N_BANK07    : ORIGIN = 0x00038000, LENGTH = 0x00008000

  SRAM_N_BANK08    : ORIGIN = 0x00040000, LENGTH = 0x00008000
  SRAM_N_BANK09    : ORIGIN = 0x00048000, LENGTH = 0x00008000
  SRAM_N_BANK10    : ORIGIN = 0x00050000, LENGTH = 0x00008000
  SRAM_N_BANK11    : ORIGIN = 0x00058000, LENGTH = 0x00008000

  SRAM_N_BANK12    : ORIGIN = 0x00060000, LENGTH = 0x00008000
  SRAM_N_BANK13    : ORIGIN = 0x00068000, LENGTH = 0x00008000
  SRAM_N_BANK14    : ORIGIN = 0x00070000, LENGTH = 0x00008000
  SRAM_N_BANK15    : ORIGIN = 0x00078000, LENGTH = 0x00008000

  SRAM_N_BANK16    : ORIGIN = 0x00080000, LENGTH = 0x00008000
  SRAM_N_BANK17    : ORIGIN = 0x00088000, LENGTH = 0x00008000
  SRAM_N_BANK18    : ORIGIN = 0x00090000, LENGTH = 0x00008000
  SRAM_N_BANK19    : ORIGIN = 0x00098000, LENGTH = 0x00008000

  SRAM_N_BANK20    : ORIGIN = 0x000A0000, LENGTH = 0x00008000
  SRAM_N_BANK21    : ORIGIN = 0x000A8000, LENGTH = 0x00008000
  SRAM_N_BANK22    : ORIGIN = 0x000B0000, LENGTH = 0x00008000
  SRAM_N_BANK23    : ORIGIN = 0x000B8000, LENGTH = 0x00008000
  
  /* SRAM far banks, [0x000C_0000, 0x001F_FFFF], only for CORE0/CORE1 Instruction */
  SRAM_F_BANK00    : ORIGIN = 0x000C0000, LENGTH = 0x00008000
  SRAM_F_BANK01    : ORIGIN = 0x000C8000, LENGTH = 0x00008000
  SRAM_F_BANK02    : ORIGIN = 0x000D0000, LENGTH = 0x00008000
  SRAM_F_BANK03    : ORIGIN = 0x000D8000, LENGTH = 0x00008000

  SRAM_F_BANK04    : ORIGIN = 0x000E0000, LENGTH = 0x00008000
  SRAM_F_BANK05    : ORIGIN = 0x000E8000, LENGTH = 0x00008000
  SRAM_F_BANK06    : ORIGIN = 0x000F0000, LENGTH = 0x00008000
  SRAM_F_BANK07    : ORIGIN = 0x000F8000, LENGTH = 0x00008000

  SRAM_F_BANK08    : ORIGIN = 0x00100000, LENGTH = 0x00008000
  SRAM_F_BANK09    : ORIGIN = 0x00108000, LENGTH = 0x00008000
  SRAM_F_BANK10    : ORIGIN = 0x00110000, LENGTH = 0x00008000
  SRAM_F_BANK11    : ORIGIN = 0x00118000, LENGTH = 0x00008000

  SRAM_F_BANK12    : ORIGIN = 0x00120000, LENGTH = 0x00008000
  SRAM_F_BANK13    : ORIGIN = 0x00128000, LENGTH = 0x00008000
  SRAM_F_BANK14    : ORIGIN = 0x00130000, LENGTH = 0x00008000
  SRAM_F_BANK15    : ORIGIN = 0x00138000, LENGTH = 0x00008000
  
  SRAM_F_BANK16    : ORIGIN = 0x00140000, LENGTH = 0x00008000
  SRAM_F_BANK17    : ORIGIN = 0x00148000, LENGTH = 0x00008000
  SRAM_F_BANK18    : ORIGIN = 0x00150000, LENGTH = 0x00008000
  SRAM_F_BANK19    : ORIGIN = 0x00158000, LENGTH = 0x00008000
  
  SRAM_F_BANK20    : ORIGIN = 0x00160000, LENGTH = 0x00008000
  SRAM_F_BANK21    : ORIGIN = 0x00168000, LENGTH = 0x00008000
  SRAM_F_BANK22    : ORIGIN = 0x00170000, LENGTH = 0x00008000
  SRAM_F_BANK23    : ORIGIN = 0x00178000, LENGTH = 0x00008000
  
  SRAM_F_BANK24    : ORIGIN = 0x00180000, LENGTH = 0x00008000
  SRAM_F_BANK25    : ORIGIN = 0x00188000, LENGTH = 0x00008000
  SRAM_F_BANK26    : ORIGIN = 0x00190000, LENGTH = 0x00008000
  SRAM_F_BANK27    : ORIGIN = 0x00198000, LENGTH = 0x00008000
  
  SRAM_F_BANK28    : ORIGIN = 0x001A0000, LENGTH = 0x00008000
  SRAM_F_BANK29    : ORIGIN = 0x001A8000, LENGTH = 0x00008000
  SRAM_F_BANK30    : ORIGIN = 0x001B0000, LENGTH = 0x00008000
  SRAM_F_BANK31    : ORIGIN = 0x001B8000, LENGTH = 0x00008000
  
  SRAM_F_BANK32    : ORIGIN = 0x001C0000, LENGTH = 0x00008000
  SRAM_F_BANK33    : ORIGIN = 0x001C8000, LENGTH = 0x00008000
  SRAM_F_BANK34    : ORIGIN = 0x001D0000, LENGTH = 0x00008000
  SRAM_F_BANK35    : ORIGIN = 0x001D8000, LENGTH = 0x00008000
  
  SRAM_F_BANK36    : ORIGIN = 0x001E0000, LENGTH = 0x00008000
  SRAM_F_BANK37    : ORIGIN = 0x001E8000, LENGTH = 0x00008000
  SRAM_F_BANK38    : ORIGIN = 0x001F0000, LENGTH = 0x00008000
  SRAM_F_BANK39    : ORIGIN = 0x001F8000, LENGTH = 0x00008000

  /* RAM for IPC */
  SRAM_CPU0_2_CPU1 : ORIGIN = 0x00200000, LENGTH = 0x00001000
  SRAM_CPU1_2_CPU0 : ORIGIN = 0x00201000, LENGTH = 0x00001000
  SRAM_CPU0_2_CLA0 : ORIGIN = 0x00202000, LENGTH = 0x00001000
  SRAM_CLA0_2_CPU0 : ORIGIN = 0x00203000, LENGTH = 0x00001000
  SRAM_CPU1_2_CLA1 : ORIGIN = 0x00204000, LENGTH = 0x00001000
  SRAM_CLA1_2_CPU1 : ORIGIN = 0x00205000, LENGTH = 0x00001000

  /* RAM for bootloader */
  BOOT_RAM_CORE0   : ORIGIN = 0x00280000, LENGTH = 0x00002000
  BOOT_RAM_CORE1   : ORIGIN = 0x00282000, LENGTH = 0x00002000

  /* Flash Memory: store instruction and data, and copy to RAM by bootloader */
  FLASH_DATA       : ORIGIN = 0x30000000, LENGTH = 0x00200000


  /*
   * Part 2:  application symbols and notes
   */

  /* 1. SRAM is allocated by BANK (32KB blocks, 0x8000)
   * 2. SRAM_N_BANKxx are free to allocate to core0/core1/cla0/cla1, for instruction or data
   * 3. SRAM_F_BANKxx are for core0/core1 instruction only
   * 4. Reserve last 4KB of SRAM of core0/core1 for interrupt vector
   * 5. DONOT allocation address 0x0 (SRAM_BANK 00) to data
   */
 
  /* CORE0 CLA IRAM: 32KB. SRAM_N_BANK 00 */
  SRAM_CORE0_CLA_INST : ORIGIN = 0x00000000, LENGTH = 0x00008000
  
  /* CORE0 CLA DRAM: 32KB. SRAM_N_BANK 01 */
  SRAM_CORE0_CLA_DATA : ORIGIN = 0x00008000, LENGTH = 0x00008000
  
  
  /* CORE0 DRAM: 96KB. SRAM_N_BANK 02 ~ 03 */
  SRAM_CORE0_DATA     : ORIGIN = 0x00010000, LENGTH = 0x00017C00
  SRAM_CORE0_IVEC     : ORIGIN = 0x00027C00, LENGTH = 0x00000400
  
  /* CORE0 IRAM: 480KB. SRAM_N_BANK 04 ~ 19 */
  SRAM_CORE0_INST     : ORIGIN = 0x00028000, LENGTH = 0x00078000
  
  /* CORE1 DRAM: 96KB. SRAM_N_BANK 20 ~ 22 */
  SRAM_CORE1_DATA     : ORIGIN = 0x000A0000, LENGTH = 0x00017C00
  SRAM_CORE1_IVEC     : ORIGIN = 0x000B7C00, LENGTH = 0x00000400

  /* CORE1 IRAM: 1312KB. SRAM_N_BANK 23 + SRAM_F_BANKS
   * NOTE: 1. Interrupt vector table cannot placed in FAR RAM, so at least one bank (32KB)
   *          of near RAM must be allocated to DSP core.
   *       2. Reserve last 512 Bytes for instruction prefetch
   */
  SRAM_CORE1_INST     : ORIGIN = 0x000B8000, LENGTH = 0x00147E00
 

  /* Fake memory regions for specifying stack size */
  STACK_CORE0      : ORIGIN = 0x00000000, LENGTH = 0x00000400
  STACK_CORE1      : ORIGIN = 0x00000000, LENGTH = 0x00000400
}
